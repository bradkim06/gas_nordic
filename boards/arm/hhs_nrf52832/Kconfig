## boards/arm/hhs_nrf52832/Kconfig
```kconfig
# nRF52 DK board configuration

# Copyright (c) 2016 Nordic Semiconductor ASA
# SPDX-License-Identifier: Apache-2.0

if BOARD_HHS_NRF52832

config BOARD_ENABLE_DCDC
	bool "DCDC mode"
	select SOC_DCDC_NRF52X
	default y
	depends on BOARD_HHS_NRF52832

module = BOARD_HHS
module-str = Board Control
source "subsys/logging/Kconfig.template.log_config"

endif # BOARD_HHS_NRF52832
```

## drivers/bme68x/Kconfig
```kconfig
# BME68X temperature, pressure, humidity and gas sensor configuration options

# Copyright (c) 2018 Bosch Sensortec GmbH
# Copyright (c) 2022, Leonard Pollak
#
# SPDX-License-Identifier: Apache-2.0

menuconfig BME68X
	bool "BME68X sensor"
	default y
	depends on DT_HAS_BOSCH_BME68X_ENABLED
	select I2C if $(dt_compat_on_bus,$(DT_COMPAT_BOSCH_BME68X),i2c)
	help
	  Enable driver for BME68X I2C- or SPI- based temperature, pressure, humidity and gas sensor.

if BME68X

choice
	prompt "BME68X temperature oversampling"
	default BME68X_TEMP_OVER_2X
	help
	  Select temperature oversampling for the BME68X sensor.  Higher values
	  lead to more accurate readings, but higher power consumption.
config BME68X_TEMP_OVER_1X
	bool "x1"
config BME68X_TEMP_OVER_2X
	bool "x2"
config BME68X_TEMP_OVER_4X
	bool "x4"
config BME68X_TEMP_OVER_8X
	bool "x8"
config BME68X_TEMP_OVER_16X
	bool "x16"
endchoice

choice
	prompt "BME68X pressure oversampling"
	default BME68X_PRESS_OVER_16X
	help
	  Select pressure oversampling for the BME68X sensor.  Higher values
	  lead to more accurate readings, but higher power consumption.
config BME68X_PRESS_OVER_1X
	bool "x1"
config BME68X_PRESS_OVER_2X
	bool "x2"
config BME68X_PRESS_OVER_4X
	bool "x4"
config BME68X_PRESS_OVER_8X
	bool "x8"
config BME68X_PRESS_OVER_16X
	bool "x16"
endchoice

choice
	prompt "BME68X humidity oversampling"
	default BME68X_HUMIDITY_OVER_1X
	help
	  Select humidity oversampling for the BME68X sensor.  Higher values
	  lead to more accurate readings, but higher power consumption.
config BME68X_HUMIDITY_OVER_1X
	bool "x1"
config BME68X_HUMIDITY_OVER_2X
	bool "x2"
config BME68X_HUMIDITY_OVER_4X
	bool "x4"
config BME68X_HUMIDITY_OVER_8X
	bool "x8"
config BME68X_HUMIDITY_OVER_16X
	bool "x16"
endchoice

choice
	prompt "BME68X IIR low-pass filter coefficient"
	default BME68X_FILTER_OFF
	help
	  Select the filter coefficient for the BME68X sensor.
config BME68X_FILTER_OFF
	bool "filter off"
config BME68X_FILTER_2
	bool "2"
config BME68X_FILTER_4
	bool "4"
config BME68X_FILTER_8
	bool "8"
config BME68X_FILTER_16
	bool "16"
config BME68X_FILTER_32
	bool "32"
config BME68X_FILTER_64
	bool "64"
config BME68X_FILTER_128
	bool "128"
endchoice

choice
	prompt "BME68X gas sensor's heater temperature in degree Celsius"
	default BME68X_HEATR_TEMP_LP
	help
	  Select the gas sensor's heater temperature for the BME68X sensor.
config BME68X_HEATR_TEMP_LP
	bool "320"
config BME68X_HEATR_TEMP_ULP
	bool "400"
endchoice

choice
	prompt "BME68X gas sensor's heating duration in milliseconds"
	default BME68X_HEATR_DUR_LP
	help
	  Select the gas sensor's heating duration for the BME68X sensor.
config BME68X_HEATR_DUR_LP
	bool "197"
config BME68X_HEATR_DUR_ULP
	bool "1943"
endchoice

endif # BME68X
```
